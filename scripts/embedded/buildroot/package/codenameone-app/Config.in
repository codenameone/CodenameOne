## scripts/embedded/buildroot/package/codenameone-app/Config.in
```kconfig
config BR2_PACKAGE_CODENAMEONE_APP
	bool "codenameone-app"
	depends on BR2_INSTALL_LIBSTDCPP
	depends on BR2_TOOLCHAIN_HAS_THREADS
	select BR2_PACKAGE_FREETYPE
	select BR2_PACKAGE_LIBPNG
	select BR2_PACKAGE_JPEG
	select BR2_PACKAGE_ZLIB
	select BR2_PACKAGE_OPENSSL
	select BR2_PACKAGE_LIBCURL
	select BR2_PACKAGE_LIBDRM
	select BR2_PACKAGE_DEJAVU
	help
	  A Codename One application on the embedded Linux port: DRM/KMS or
	  fbdev, evdev input, no X11 or Wayland. Builds the project ParparVM
	  translated (scripts/embedded/translate.sh) and starts it at boot.

config BR2_PACKAGE_CODENAMEONE_APP_DIST
	string "translated dist directory"
	depends on BR2_PACKAGE_CODENAMEONE_APP
	help
	  Absolute path of the dist/ directory translate.sh wrote.

config BR2_PACKAGE_CODENAMEONE_APP_NAME
	string "executable name"
	default "Main"
	depends on BR2_PACKAGE_CODENAMEONE_APP
	help
	  The application's main class name, which is the executable's name.
```
